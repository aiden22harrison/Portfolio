// Graphical Library for the OLED's
#include <SPI.h>
#include <Wire.h>
#include <Adafruit_GFX.h>
#include <Adafruit_SSD1306.h>

#define SCREEN_WIDTH 128 // OLED display width, in pixels
#define SCREEN_HEIGHT 64 // OLED display height, in pixels

// Declaration for an SSD1306 display connected to I2C (SDA, SCL pins)
#define OLED_RESET     -1 // Reset pin # (or -1 if sharing Arduino reset pin)
Adafruit_SSD1306 display(SCREEN_WIDTH, SCREEN_HEIGHT, &Wire, OLED_RESET);

#include <Adafruit_NeoPixel.h>
#ifdef __AVR__
#include <avr/power.h> // Required for 16 MHz Adafruit Trinket
#endif

#define PIN      6
#define NUMPIXELS 8

// Starfleet Logo Image
const unsigned char PROGMEM starfleetLogo[] = {
  0xff, 0xff, 0xff, 0xff, 0xff, 0xff, 0xff, 0xff, 0xff, 0xff, 0xff, 0xff, 0xff, 0xff, 0xff, 0xff,
  0xff, 0xff, 0xff, 0xff, 0xff, 0xff, 0xff, 0xff, 0xff, 0xff, 0xff, 0xfe, 0x3f, 0xff, 0xff, 0xff,
  0xff, 0xff, 0xff, 0xfc, 0x1f, 0xff, 0xff, 0xff, 0xff, 0xff, 0xff, 0xf8, 0x0f, 0xff, 0xff, 0xff,
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  0xff, 0xff, 0xff, 0xff, 0xff, 0xff, 0xff, 0xff, 0xff, 0xff, 0xff, 0xff, 0xff, 0xff, 0xff, 0xff
};


Adafruit_NeoPixel pixels(NUMPIXELS, PIN, NEO_GRB + NEO_KHZ800);

#define DELAYVAL 500 // Time (in milliseconds) to pause between pixels

const int buttonPin = 2;

int buttonState = 0;

int greenValue1 = 0;
int greenValue2 = 0;


void setup() {
  pixels.begin();
  pinMode(buttonPin, INPUT);

  // This is for the OLED Display (.96 inch)
  Serial.begin(115200);

  if (!display.begin(SSD1306_SWITCHCAPVCC, 0x3C)) { // Address 0x3D for 128x64
    Serial.println(F("SSD1306 allocation failed"));
  }
  delay(2000);
  display.clearDisplay();
}

void loop() {
  buttonState = digitalRead(buttonPin);
  if (buttonState == 1) {
    scanning();
    primaryDisplayRandom();
  }
  
  else {
    idle();
  }
}

void scanning() {
  pixels.clear();
  pixels.setBrightness(10);
  for (int i = 0; i <= 8; i++) {
    pixels.setPixelColor(i, pixels.Color(255, 255, 255));
  }
  pixels.show();
  for (int j = 0; j <= 5; j++) {
    for (int i = -2; i <= 8; i++) {
      pixels.setPixelColor(i, pixels.Color(0, 255, 0));
      pixels.setPixelColor(i + 1, pixels.Color(0, 255, 0));
      pixels.setPixelColor(i + 2, pixels.Color(0, 255, 0));
      pixels.setPixelColor(i - 1, pixels.Color(255, 255, 255));
      pixels.show();
      delay(50);
    }
  }
  delay(1000);
  clearPixels();
}

void idle() {
  pixels.setBrightness(10);
  greenValue1 = 255;
  greenValue2 = 0;
  for (int j = 0; j <= 2; j++) {
    
    for (int i = 0; i <= 8; i += 2) {
      pixels.setPixelColor(i, pixels.Color(0, greenValue1, 0));
    }
    
    for (int x = 1; x <=8; x += 2) {
      pixels.setPixelColor(x, pixels.Color(0, greenValue2, 0));
    }
    
    greenValue1 = 0;
    greenValue2 = 255;
    delay(1000);
  }
  delay(1000);
}

void clearPixels() {
  for (int i = 0; i <= 8; i++) {
    pixels.setPixelColor(i, pixels.Color(0, 0, 0));
    pixels.show();
  }
}

void primaryDisplayRandom() {
  display.clearDisplay();
  display.display();
  switch (random(1,3)) {
    case 1:
      display.drawBitmap((display.width() - 64) / 2, (display.height() - 64) / 2, starfleetLogo, 64, 64, WHITE);
      display.display();
      Serial.print("Case 1 ");
      break;
    case 2:
      Serial.print("Case 2 ");
      display.setTextSize(1);
      display.setTextColor(WHITE);
      display.setCursor(0, 0);
      display.println("Starfleet Medical");
      display.setCursor(0, 20);
      display.println("Error: 0xd3127394 0x203a9926");
      display.display();
      break;
  }

}
